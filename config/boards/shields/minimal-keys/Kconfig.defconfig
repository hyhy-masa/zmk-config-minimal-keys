## config/boards/shields/minimal-keys/Kconfig.defconfig
```kconfig
if SHIELD_MINIMAL_KEYS_RIGHT

config ZMK_KEYBOARD_NAME
    default "minimal-keys_R"

config ZMK_SPLIT
    default y

config ZMK_SPLIT_ROLE_CENTRAL
    default y

endif

if SHIELD_MINIMAL_KEYS_LEFT

config ZMK_KEYBOARD_NAME
    default "minimal-keys_L"

config ZMK_SPLIT
    default y

endif

if SHIELD_MINIMAL_KEYS_RIGHT|| SHIELD_MINIMAL_KEYS_LEFT

config ZMK_SPLIT
    default y
    
config NFCT_PINS_AS_GPIOS
    default y

config ZMK_SPLIT
    default y

config INPUT
    default y

config ZMK_POINTING
    default y

config SPI
    default y

config PMW3610
    default y

config PMW3610_SWAP_XY
    default y

config RGBLED_WIDGET_BATTERY_LEVEL_HIGH
    default 30

config RGBLED_WIDGET_BATTERY_LEVEL_CRITICAL
    default 10

endif
```

## config/boards/shields/minimal_keys/Kconfig.defconfig
```kconfig
if SHIELD_MINIMAL_KEYS_LEFT

config ZMK_KEYBOARD_NAME
    default "minimal-keys_L"

    config ZMK_SPLIT
    default y

endif

if SHIELD_MINIMAL_KEYS_RIGHT

config ZMK_KEYBOARD_NAME
    default "minimal-keys_R"

    config ZMK_SPLIT
    default y

    config ZMK_SPLIT_ROLE_CENTRAL
    default y

endif
```

## config/boards/shields/minimal_keys/Kconfig.shield
```kconfig
config SHIELD_MINIMAL_KEYS_LEFT
    def_bool $(shields_list_contains,minimal_keys_left)

config SHIELD_MINIMAL_KEYS_RIGHT
    def_bool $(shields_list_contains,minimal_keys_right)
```

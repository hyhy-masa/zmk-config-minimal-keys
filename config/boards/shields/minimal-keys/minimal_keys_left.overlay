#include "minimal_keys.dtsi"

&kscan0 {
    col-gpios
        = <&xiao_d 10 GPIO_ACTIVE_HIGH>
        , <&xiao_d 9 GPIO_ACTIVE_HIGH> 
        , <&xiao_d 8 GPIO_ACTIVE_HIGH> 
        , <&xiao_d 7 GPIO_ACTIVE_HIGH> 
        , <&gpio0 10 GPIO_ACTIVE_HIGH>
        , <&gpio0 9 GPIO_ACTIVE_HIGH>
        ;
        
    // チャーリープレックスマトリックスサポートを追加
    compatible = "zmk,kscan-gpio-charlieplex";
    wakeup-source;
    
    // 割り込みGPIOピン（低消費電力モード用）
    interrupt-gpios = <&xiao_d 1 (GPIO_ACTIVE_HIGH | GPIO_PULL_DOWN)>;
    
    // GPIOピンをチャーリープレックス用に使用（col-gpiosと同じピンを使用）
    gpios = <&xiao_d 10 GPIO_ACTIVE_HIGH>
          , <&xiao_d 9 GPIO_ACTIVE_HIGH> 
          , <&xiao_d 8 GPIO_ACTIVE_HIGH> 
          , <&xiao_d 7 GPIO_ACTIVE_HIGH> 
          , <&gpio0 10 GPIO_ACTIVE_HIGH>
          , <&gpio0 9 GPIO_ACTIVE_HIGH>
          ;
};

&left_encoder {
    status = "okay";
};


#include <zephyr/dt-bindings/input/input-event-codes.h>
&spi0 {
    status = "okay";
    compatible = "nordic,nrf-spim";
    pinctrl-0 = <&spi0_default>;
    pinctrl-1 = <&spi0_sleep>;
    pinctrl-names = "default", "sleep";
    cs-gpios = <&gpio0 9 GPIO_ACTIVE_LOW>;


};
